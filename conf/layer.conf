## conf/layer.conf
```bitbake
# We have a conf and classes directory, add to BBPATH
BBPATH =. "${LAYERDIR}:"

# We have recipes-* directories, add to BBFILES
BBFILES += "${LAYERDIR}/recipes-*/*/*.bb \
            ${LAYERDIR}/recipes-*/*/*.bbappend"

BBFILE_COLLECTIONS += "diaspberry"
BBFILE_PATTERN_diaspberry = "^${LAYERDIR}/"
BBFILE_PRIORITY_diaspberry = "5"

# This should only be incremented on significant changes that will
# cause compatibility issues with other layers
LAYERVERSION_diaspberry = "1"

LAYERDEPENDS_diaspberry = "raspberrypi"

REQUIRED_POKY_BBLAYERS_CONF_VERSION = "2"
```
